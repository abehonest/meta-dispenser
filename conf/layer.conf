## conf/layer.conf
```bitbake
# We have a conf and classes directory, add to BBPATH
BBPATH .= ":${LAYERDIR}"

# We have recipes-* directories, add to BBFILES
BBFILES += "${LAYERDIR}/recipes-*/*/*.bb \
            ${LAYERDIR}/recipes-*/*/*.bbappend"

BBFILE_COLLECTIONS += "meta-dispenser"
BBFILE_PATTERN_meta-dispenser = "^${LAYERDIR}/"
BBFILE_PRIORITY_meta-dispenser = "6"

LAYERDEPENDS_meta-dispenser = "core"
LAYERSERIES_COMPAT_meta-dispenser = "kirkstone"
```
